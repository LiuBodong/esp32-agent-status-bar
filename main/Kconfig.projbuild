## main/Kconfig.projbuild
```kconfig
menu "Vibe Coding Status Bar"

    menu "Display (SSD1315 / SSD1306 OLED)"

        config STATUS_BAR_LCD_H_RES
            int "LCD horizontal resolution"
            range 64 256
            default 128

        config STATUS_BAR_LCD_V_RES
            int "LCD vertical resolution (32 for 0.96 inch bar screen)"
            range 16 64
            default 32

        config STATUS_BAR_I2C_SDA_GPIO
            int "I2C SDA GPIO"
            default 8
            help
                注意：ESP32-C3 的 USB 占用了 GPIO18(D-) / GPIO19(D+)，
                不要与这两个引脚冲突。

        config STATUS_BAR_I2C_SCL_GPIO
            int "I2C SCL GPIO"
            default 9

        config STATUS_BAR_I2C_FREQ_HZ
            int "I2C clock frequency (Hz)"
            default 400000

        config STATUS_BAR_I2C_ADDR
            hex "I2C slave address (7-bit)"
            default 0x3C
            help
                常见 OLED 模块为 0x3C，少数为 0x3D。

        config STATUS_BAR_LCD_RST_GPIO
            int "LCD reset GPIO (-1 if the module has no RST pin)"
            default -1

        config STATUS_BAR_LCD_MIRROR_X
            bool "Mirror X"
            default n

        config STATUS_BAR_LCD_MIRROR_Y
            bool "Mirror Y"
            default n

        config STATUS_BAR_LCD_INVERT
            bool "Invert colors"
            default n
            help
                若显示内容黑白反了（背景发亮、文字变黑），打开此项。

    endmenu

    menu "UI"

        config STATUS_BAR_PAGE_INTERVAL_MS
            int "Carousel page interval (ms, 0 = disable carousel)"
            default 4000

        config STATUS_BAR_REFRESH_MS
            int "UI refresh period (ms)"
            range 50 2000
            default 200

        config STATUS_BAR_LINK_TIMEOUT_MS
            int "Host link timeout (ms)"
            default 10000
            help
                超过该时间没有收到 host 数据，屏幕会提示 NO HOST。
                建议至少是主机保活间隔（Pi 扩展默认 2s）的 3 倍：主机侧偶尔漏一帧
                不该让屏幕闪 NO HOST。

        config STATUS_BAR_SCREEN_OFF_MS
            int "Blank the panel after the link is down for (ms, 0 = never)"
            default 60000
            help
                没有主机（断链，或者上电后一直没连上）持续该时长后关闭面板显示，
                等下一次收到 host 数据再亮回来。用来避免没人用的时候屏幕一直亮着。
                填 0 表示永远不熄屏。

        config STATUS_BAR_BOOT_SELFTEST
            bool "Flash the whole screen once at boot (bring-up check)"
            default y
            help
                上电后整屏点亮 400ms 再熄灭，用来确认屏幕接线、I2C、
                刷新链路和单色转换都正常。调通之后可以关掉。

    endmenu

    menu "Status LED (SK6812 RGBW)"

        config STATUS_BAR_LED_ENABLE
            bool "Enable the SK6812 status LED"
            default y
            help
                关掉后不再初始化 RMT 灯带，也不起灯效任务（串口的 led 命令会静默失效）。

        config STATUS_BAR_LED_GPIO
            int "SK6812 data GPIO"
            default 4
            depends on STATUS_BAR_LED_ENABLE
            help
                数据线接灯珠的 Din（单颗使用时 Dout 悬空）。中间建议串 330Ω。
                避开 strapping 脚（GPIO2/8/9）、UART0（GPIO20/21）和 USB（GPIO18/19）。

        config STATUS_BAR_LED_BRIGHTNESS
            int "Default brightness (0-255, 255 = full)"
            range 0 255
            default 40
            depends on STATUS_BAR_LED_ENABLE
            help
                主亮度，默认压到 40/255（约 16%），单色屏旁边一颗小灯不至于晃眼。
                运行时可用串口 {"cmd":"led","brightness":N} 临时改，但不落盘，重启回到这里。

        config STATUS_BAR_LED_RGBW_ORDER
            bool "Use RGBW byte order instead of GRBW"
            default n
            depends on STATUS_BAR_LED_ENABLE
            help
                SK6812 RGBW 的字节序按厂家批次可能是 GRBW（默认）或 RGBW。
                点红亮绿 = 序反了，把这个打开；再不对就按 docs/led_ctrol.md 坑 2 自定义。

        config STATUS_BAR_LED_REFRESH_MS
            int "Effect refresh period (ms)"
            range 10 500
            default 40
            depends on STATUS_BAR_LED_ENABLE
            help
                灯效任务的刷新周期，默认 40ms（约 25fps）。调大更省电，但呼吸/旋转会变卡。

        config STATUS_BAR_LED_BOOT_SELFTEST
            bool "Sweep R/G/B/W once at boot"
            default y
            depends on STATUS_BAR_LED_ENABLE
            help
                上电依次点亮红/绿/蓝/白各 150ms：确认接线，也能一眼看出字节序对不对。

    endmenu

    menu "USB Serial/JTAG link"

        config STATUS_BAR_RX_BUFFER_SIZE
            int "USB Serial/JTAG RX ring buffer size"
            default 1024

        config STATUS_BAR_TX_BUFFER_SIZE
            int "USB Serial/JTAG TX ring buffer size"
            default 512

        config STATUS_BAR_MAX_LINE_LEN
            int "Max JSON line length (bytes)"
            range 128 2048
            default 512

        config STATUS_BAR_HEARTBEAT_MS
            int "Heartbeat interval to host (ms, 0 = disable)"
            default 10000

        config STATUS_BAR_LOG_RX
            bool "Log every received JSON line"
            default n

    endmenu

endmenu
```
